## yocto/custom-yocto-3.1/build/conf/bblayers.conf
```bitbake
# POKY_BBLAYERS_CONF_VERSION is increased each time build/conf/bblayers.conf
# changes incompatibly
POKY_BBLAYERS_CONF_VERSION = "2"

BBPATH = "${TOPDIR}"
BBFILES ?= ""

BSPDIR := "${@os.path.abspath(os.path.dirname(d.getVar('FILE', True)) + '/../..')}"

BBLAYERS ?= " \
  ${BSPDIR}/sources/poky/meta \
  ${BSPDIR}/sources/poky/meta-poky \
  ${BSPDIR}/sources/poky/meta-yocto-bsp \
  ${BSPDIR}/sources/meta-openembedded/meta-oe \
  ${BSPDIR}/sources/meta-openembedded/meta-multimedia \
  ${BSPDIR}/sources/meta-openembedded/meta-python \
  ${BSPDIR}/sources/meta-openembedded/meta-filesystems \
  ${BSPDIR}/sources/meta-openembedded/meta-gnome \
  ${BSPDIR}/sources/meta-openembedded/meta-networking \
  ${BSPDIR}/sources/meta-freescale \
  ${BSPDIR}/sources/meta-freescale-3rdparty \
  ${BSPDIR}/sources/meta-freescale-distro \
  ${BSPDIR}/sources/meta-swupdate \
  ${BSPDIR}/sources/meta-qt5 \
  ${BSPDIR}/sources/meta-virtualization \
  ${BSPDIR}/sources/meta-variscite-fslc \
  "
```

## yocto/yocto-master/build/conf/bblayers.conf
```bitbake
# POKY_BBLAYERS_CONF_VERSION is increased each time build/conf/bblayers.conf
# changes incompatibly
POKY_BBLAYERS_CONF_VERSION = "2"

BBPATH = "${TOPDIR}"
BBFILES ?= ""

#  /yocto/yocto-master/sources/poky/meta-yocto-bsp

BBLAYERS ?= " \
  /yocto/yocto-master/sources/poky/meta \
  /yocto/yocto-master/sources/poky/meta-poky \
  /yocto/yocto-master/sources/meta-openembedded/meta-oe \
  /yocto/yocto-master/sources/meta-openembedded/meta-multimedia \
  /yocto/yocto-master/sources/meta-openembedded/meta-python \
  /yocto/yocto-master/sources/meta-openembedded/meta-filesystems \
  /yocto/yocto-master/sources/meta-openembedded/meta-gnome \
  /yocto/yocto-master/sources/meta-openembedded/meta-networking \
  /yocto/yocto-master/sources/meta-freescale \
  /yocto/yocto-master/sources/meta-freescale-3rdparty \
  /yocto/yocto-master/sources/meta-freescale-distro \
  /yocto/yocto-master/sources/meta-swupdate \
  /yocto/yocto-master/sources/meta-qt5 \
  /yocto/yocto-master/sources/meta-virtualization \
  /yocto/yocto-master/sources/meta-variscite-fslc \
  "
```
